
#include <zephyr.h>
#include <sys/printk.h>

#include <settings/settings.h>

#include <bluetooth/bluetooth.h>
#include <bluetooth/mesh.h>
#include <bluetooth/hci.h>
#include <bluetooth/conn.h>
#include <bluetooth/uuid.h>
#include <bluetooth/gatt.h>
#include <drivers/pwm.h>
#include "display.h"
#include "controller.h"
#include "console.h"
#include "sound.h"
#include "invaders.h"
#include "mesh.h"

void sao_test()
{
	/* P0.24 - test ok, 
	 * P0.13 - test ok,
	 * P0.18 - NOT OK
	 * POWER subsystem at offset 0x40000000
	 * PSELRESET0 at offset 200
	 * PSELRESET1 at offset 204
	 * P1.09 - test ok
	*/
	static const struct device *gpio0,*gpio1;
	uint32_t * pselreset0 = (uint32_t *)0x40000200;
	uint32_t * pselreset1 = (uint32_t *)0x40000204; 
	*pselreset0=0x80000000;
	*pselreset1=0x80000000;
	gpio0=device_get_binding("GPIO_0");
	gpio1=device_get_binding("GPIO_1");
	gpio_pin_configure(gpio0,18,GPIO_OUTPUT);
	
	printk("0 = %x ",*pselreset0);
	printk("1 = %x\n",*pselreset1);
	while(1)
	{
		gpio_pin_set(gpio0,18,1);
		k_msleep(100);
		gpio_pin_set(gpio0,18,0);
		k_msleep(100);
	}
	
}
extern console Console;
#define TILE_WIDTH 30
#define TILE_HEIGHT 30
#define SPRITE_WIDTH 20
#define SPRITE_HEIGHT 25
const uint16_t tile[]={
0,
0,
0,
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65287,
};
void drawTile(int row, int col)
{
	Console.Display.putImage(row*TILE_WIDTH,col*TILE_HEIGHT,TILE_WIDTH,TILE_HEIGHT,(uint16_t *)&tile[0]);
}
void drawTile2(int row, int col)
{
	Console.Display.fillRectangle(row*TILE_WIDTH,col*TILE_HEIGHT,TILE_WIDTH,TILE_HEIGHT,0xffff);
}
void drawLandscape()
{

	int row,col;
	
	for (row=0;row<SCREEN_HEIGHT/TILE_HEIGHT;row++)
	{
		for (col=0;col<SCREEN_WIDTH/TILE_WIDTH;col++)
		{
			drawTile(row,col);
		}
	}
}

uint8_t dirty_flags[]={0,0,0,0,0,0,0,0};
void flagDirty(int row, int col)
{
	dirty_flags[row] |= (1 << col);
}
void flagClean(int row, int col)
{
	dirty_flags[row] &= ~(1 << col);
}
int isDirty(int row, int col)
{
	if (dirty_flags[row] & (1 << col))
		return 1;
	else
		return 0;
}
void check_for_overlap(int x,int y, int w, int h)
{
	// incoming arguments are the bounding rectangle for a sprite
	// This function checks to see if that sprite overlaps each
	// background screen tile.
	int row,col;
	for (row=0;row<SCREEN_HEIGHT/TILE_HEIGHT;row++)
	{
		for (col=0;col<SCREEN_WIDTH/TILE_WIDTH;col++)
		{
			
			// check top left corner
			if ((x >=row*TILE_WIDTH) && (y >= col*TILE_HEIGHT) &&
				((x) < (row+1)*TILE_WIDTH) && ((y) < (col+1)*TILE_HEIGHT) )
			{
				flagDirty(row,col);				
			}
			// check top right
			if (((x+w) >=row*TILE_WIDTH) && (y >= col*TILE_HEIGHT) &&
				((x+w) < (row+1)*TILE_WIDTH) && ((y) < (col+1)*TILE_HEIGHT) )
			{
				flagDirty(row,col);				
			}
			// check bottom left corner
			if ((x >=row*TILE_WIDTH) && ((y+h) >= col*TILE_HEIGHT) &&
				((x) < (row+1)*TILE_WIDTH) && ((y+h) < (col+1)*TILE_HEIGHT) )
			{
				flagDirty(row,col);				
			}
			// check bottom right
			if (((x+w) >=row*TILE_WIDTH) && ((y+w) >= col*TILE_HEIGHT) &&
				((x+w) < (row+1)*TILE_WIDTH) && ((y+w) < (col+1)*TILE_HEIGHT) )
			{
				flagDirty(row,col);				
			}
		}
	}	
}
void drawCharacter(int x, int y)
{
	
	// 1f00 = blue
	// 00f8 = red
	// e007 = green
	
	Console.Display.fillRectangle(x,y,SPRITE_WIDTH,SPRITE_HEIGHT,4);
}
void moveCharacter()
{
	int x,y;
	int row,col;
	x = 0; y = 0;
	while(1)
	{

		for (row=0;row<SCREEN_HEIGHT/TILE_HEIGHT;row++)
		{
			for (col=0;col<SCREEN_WIDTH/TILE_WIDTH;col++)
			{
				if (isDirty(row,col))
				{
					drawTile(row,col);
					flagClean(row,col);
				}
			}
		}		
		drawCharacter(x,y);
		k_msleep(70);
		check_for_overlap(x,y,SPRITE_WIDTH,SPRITE_HEIGHT);
		x++;
		if (x >= (SCREEN_WIDTH-SPRITE_WIDTH))
			x=0;
		y++;
		if (y >= (SCREEN_HEIGHT-SPRITE_HEIGHT))
			y = 0;
		
	}
}
void main(void)
{
	
	
	int ret;
	int count=0;	
	ret = Console.begin();	
	uint8_t msg_count = 0;
	mesh_begin();
	if (ret < 0)
	{
		printk("\nError initializing console.  Error code = %d\n",ret);
		while(1);
	}	
	//playInvaders(0);		
	drawLandscape();
	moveCharacter();
	while(1)
	{
		
		//printk("Hello World! %s\n", CONFIG_BOARD);
       //Display.drawRectangle(random(0,119),random(0,119),random(0,120),random(0,120),random(0,0xffff));                                
       //Console.Display.fillRectangle(Console.random(0,240),Console.random(0,240),Console.random(0,240),Console.random(0,240),Console.random(0,0xffff));                   
       // display_drawCircle(random(0,240),random(0,240),random(0,135),random(0,0xffff));
        //Display.fillCircle(random(0,240),random(0,135),random(0,120),random(0,0xffff));
        count++;
        if (count >= 50) 
        {
            //Console.Display.fillRectangle(0,0,SCREEN_WIDTH,SCREEN_HEIGHT,0);
			
		//	Console.Display.print("Starting over",sizeof("Starting over")-1,20,60,0xffff,0);
            count = 0;
		//	sendDMBMessage(msg_count++);

			//printk("restarting\n");
			printk("Buttons = %x\n",Console.Controller.getButtonState());
 		//	printk("Buttons = %d\r\n",Console.Controller.getButtonState());
        }
        
	}
}
